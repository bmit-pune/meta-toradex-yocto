## conf/layer.conf
```bitbake
# We have a conf and classes directory, append to BBPATH
BBPATH .= ":${LAYERDIR}"

# We have a recipes directory, add to BBFILES
BBFILES += "${LAYERDIR}/recipes*/*/*.bb ${LAYERDIR}/recipes*/*/*.bbappend"

BBFILE_COLLECTIONS += "meta-toradex"
BBFILE_PATTERN_meta-toradex := "^${LAYERDIR}/"
BBFILE_PRIORITY_meta-toradex = "90"
```

## conf/machine/apalis-t30.conf
```bitbake
#@TYPE: Machine
#@NAME: apalis_t30
#@DESCRIPTION: Toradex Apalis T30

SOC_FAMILY = "tegra:tegra3"
require conf/machine/include/soc-family.inc

PREFERRED_PROVIDER_virtual/kernel = "linux-toradex"

KERNEL_IMAGETYPE = "uImage"

PREFERRED_PROVIDER_u-boot = "u-boot-toradex"
PREFERRED_PROVIDER_virtual/bootloader = "u-boot-toradex"
UBOOT_MACHINE = "apalis_t30_defconfig"
UBOOT_ENTRYPOINT = "0x82008000"
UBOOT_LOADADDRESS = "${UBOOT_ENTRYPOINT}"
KEEPUIMAGE = ""

PREFERRED_PROVIDER_virtual/xserver_tegra = "xserver-xorg"
PREFERRED_VERSION_xserver-xorg_tegra = "99:1.14%"
XSERVER = "xserver-xorg \
           xf86-input-evdev \
           xf86-input-mouse \
           xf86-video-fbdev \
           xf86-input-keyboard"
# Only has DVI connector for external screen, name is changing to MACHINE_GUI_CLASS
GUI_MACHINE_CLASS = "bigscreen"
MACHINE_GUI_CLASS = "bigscreen"

PREFERRED_PROVIDER_lxde-icon-theme_apalis-t30 = "lxde-icon-theme"
PREFERRED_PROVIDER_lxsession-lite_apalis-t30 = "lxsession"
PREFERRED_PROVIDER_virtual/psplash = "psplash-angstrom"
PREFERRED_PROVIDER_psplash-support = "psplash-angstrom"

PREFERRED_PROVIDER_virtual/mesa = "mesa"
PREFERRED_PROVIDER_virtual/egl = "trdx-nv-binaries"
PREFERRED_PROVIDER_virtual/libgles1 = "trdx-nv-binaries"
PREFERRED_PROVIDER_virtual/libgles2 = "trdx-nv-binaries"

MACHINE_FEATURES = "screen usbgadget usbhost vfat ext2 alsa touchscreen wifi bluetooth 3g pci "
EXTRA_IMAGEDEPENDS += "u-boot"

# used by sysvinit_2
SERIAL_CONSOLE = "115200 ttyS0"
IMAGE_FSTYPES ?= "tar.bz2"

DEFAULTTUNE = "armv7ahf-neon"
require conf/machine/include/tune-cortexa9.inc
```

## conf/machine/colibri-t20.conf
```bitbake
#@TYPE: Machine
#@NAME: colibri_t20
#@DESCRIPTION: Toradex Colibri T20

SOC_FAMILY = "tegra:tegra2"
require conf/machine/include/soc-family.inc

PREFERRED_PROVIDER_virtual/kernel = "linux-toradex"

KERNEL_IMAGETYPE = "zImage"

PREFERRED_PROVIDER_u-boot = "u-boot-toradex"
PREFERRED_PROVIDER_virtual/bootloader = "u-boot-toradex"
UBOOT_MACHINE = "colibri_t20_defconfig"
UBOOT_ENTRYPOINT = "0x00008000"

PREFERRED_PROVIDER_virtual/xserver_tegra = "xserver-xorg"
PREFERRED_VERSION_xserver-xorg_tegra = "99:1.14%"
XSERVER = "xserver-xorg \
           xf86-input-evdev \
           xf86-input-mouse \
           xf86-video-fbdev \
           xf86-input-keyboard"
# Only has DVI connector for external screen, name is changing to MACHINE_GUI_CLASS
GUI_MACHINE_CLASS = "bigscreen"
MACHINE_GUI_CLASS = "bigscreen"

PREFERRED_PROVIDER_lxde-icon-theme_colibri-t20 = "lxde-icon-theme"
PREFERRED_PROVIDER_lxsession-lite_colibri-t20 = "lxsession"
PREFERRED_PROVIDER_virtual/psplash = "psplash-angstrom"
PREFERRED_PROVIDER_psplash-support = "psplash-angstrom"

PREFERRED_PROVIDER_virtual/mesa = "mesa"
PREFERRED_PROVIDER_virtual/egl = "trdx-nv-binaries"
PREFERRED_PROVIDER_virtual/libgles1 = "trdx-nv-binaries"
PREFERRED_PROVIDER_virtual/libgles2 = "trdx-nv-binaries"

MACHINE_FEATURES = "screen usbgadget usbhost vfat ext2 alsa touchscreen wifi bluetooth 3g"
EXTRA_IMAGEDEPENDS += "u-boot"

# used by sysvinit_2
SERIAL_CONSOLE = "115200 ttyS0"
IMAGE_FSTYPES ?= "tar.bz2"

# T20 does not have neon
DEFAULTTUNE = "armv7ahf"
#choose a specific vfp, or we end up with the default vfpv2 optimization
TUNE_CCARGS += "-mfpu=vfpv3-d16"
require conf/machine/include/tune-cortexa9.inc
```

## conf/machine/colibri-vf.conf
```bitbake
#@TYPE: Machine
#@NAME: colibri_vf50/colibri_vf61 SOM powered by Freescale Vybrid family
#@SOC: vf50 vf61
#@DESCRIPTION: Toradex Colibri VF50, Colibri VF61

# meta-angstrom/conf/distro/include/arm-defaults.inc
DEFAULTTUNE = "armv7ahf-neon"
require conf/machine/include/imx-base.inc
require conf/machine/include/tune-cortexa5.inc

SOC_FAMILY = "vf:vf60"

PREFERRED_PROVIDER_virtual/kernel ?= "linux-toradex-vf"
KERNEL_IMAGETYPE = "zImage"
KERNEL_DEVICETREE += "vf500-colibri-eval-v3.dtb vf610-colibri-eval-v3.dtb"

# U-Boot reads the kernel and device tree directly from rootfs
IMAGE_INSTALL_append = " kernel-image kernel-devicetree"

PREFERRED_PROVIDER_u-boot = "u-boot-toradex-fsl"
PREFERRED_PROVIDER_virtual/bootloader = "u-boot-toradex-fsl"
UBOOT_MACHINE = "colibri_vf_defconfig"
UBOOT_SUFFIX = "imx"
UBOOT_MAKE_TARGET = ""

#All other Toradex modules require version 1.14, so stay with it also with the VF modules
PREFERRED_PROVIDER_virtual/xserver_vf = "xserver-xorg"
PREFERRED_VERSION_xserver-xorg_vf = "1.14%"

# note that this is a pure SW solution, don't expect GPU performance
PREFERRED_PROVIDER_virtual/mesa = "mesa"
PREFERRED_PROVIDER_virtual/gl = "mesa"
PREFERRED_PROVIDER_virtual/libgl = "mesa"

SDCARD_ROOTFS ?= "${DEPLOY_DIR_IMAGE}/${IMAGE_NAME}.rootfs.ext3"
IMAGE_FSTYPES ?= "tar.bz2 ext3 sdcard"

SERIAL_CONSOLES = "115200;ttyLP0 115200;ttyGS0"

MACHINE_FEATURES = "screen usbgadget usbhost vfat alsa touchscreen wifi bluetooth 3g"
EXTRA_IMAGEDEPENDS += "u-boot"

#Workaround
#if there is /dev/null with correct major and minor number, the userspace RS232
#console gobbles most of the output. Sometimes there is a kernel oops during
#init. So don't provide any device files during in the rootfs and let the
#tempdevfs do the work
USE_DEVFS = "1"
```
